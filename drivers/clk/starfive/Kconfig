## drivers/clk/starfive/Kconfig
```kconfig
# SPDX-License-Identifier: GPL-2.0

config CLK_STARFIVE
	bool "StarFive SoC driver support"
	depends on CLK
	help
	  SoC drivers for StarFive Linux-capable SoCs.
```

## drivers/net/Kconfig.dw
```kconfig
config ETH_DESIGNWARE_FIXED_BUFF
	depends on ETH_DESIGNWARE
	bool "Fixed memory buffers for Synopsys Designware Ethernet MAC"
	default y if TARGET_STARFIVE_JH7100

if ETH_DESIGNWARE_FIXED_BUFF

config ETH_DESIGNWARE_FIXED_TX_MAC_DES_BASE
	hex "Fixed base for fixed_tx_mac_descrtable"
	default 0x18001000

config ETH_DESIGNWARE_FIXED_RX_MAC_DES_BASE
	hex "Fixed base for fixed_rx_mac_descrtable"
	default 0x18002000

config ETH_DESIGNWARE_FIXED_TXBUFF_BASE
	hex "Fixed base for fixed_txbuffs"
	default 0x18010000

config ETH_DESIGNWARE_FIXED_RXBUFF_BASE
	hex "Fixed base for fixed_rxbuffs"
	default 0x18018000

endif #ETH_DESIGNWARE_FIXED_BUFF
```
